## yocto-study/meta-mscdevelop/conf/layer.conf
```bitbake
# We have a conf and classes directory, add to BBPATH
BBPATH .= ":${LAYERDIR}"

# We have recipes-* directories, add to BBFILES
BBFILES += "${LAYERDIR}/recipes-*/*/*.bb \
	${LAYERDIR}/recipes-*/*/*.bbappend"

BBFILE_COLLECTIONS += "mscdevelop"
BBFILE_PATTERN_mscdevelop = "^${LAYERDIR}/"
BBFILE_PRIORITY_mscdevelop = "6"
```
